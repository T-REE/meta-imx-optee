## conf/distro/internal-x11-optee.conf
```bitbake
# i.MX DISTRO for X11 with OPTEE

require conf/distro/fsl-imx-internal-x11.conf
require conf/distro/include/imx-optee.inc

DISTRO = "internal-x11-optee"
```

## conf/distro/internal-xwayland-optee.conf
```bitbake
# i.MX DISTRO for XWayland with OPTEE

require conf/distro/fsl-imx-internal-xwayland.conf
require conf/distro/include/imx-optee.inc

DISTRO = "internal-xwayland-optee"
```

## conf/layer.conf
```bitbake
# We have a conf and classes directory, add to BBPATH
BBPATH .= ":${LAYERDIR}"

# We have a packages directory, add to BBFILES
BBFILES += "${LAYERDIR}/recipes-*/*/*.bb \
            ${LAYERDIR}/recipes-*/*/*.bbappend"

BBFILE_COLLECTIONS += "meta-imx-optee"
BBFILE_PATTERN_meta-imx-optee := "^${LAYERDIR}"
BBFILE_PRIORITY_meta-imx-optee = "8"

IMAGE_INSTALL_append = " ${@bb.utils.contains('COMBINED_FEATURES', 'optee', 'packagegroup-fsl-optee', '', d)}"
```
